## main/Kconfig.projbuild
```kconfig
menu "PS2Keyboard Configuration"

    config ESP_WIFI_SSID
        string "WiFi SSID"
        default ""
        help
            SSID (network name) to connect to.

    config ESP_WIFI_PASSWORD
        string "WiFi Password"
        default ""
        help
            WiFi password (WPA or WPA2) to use.

endmenu
```
